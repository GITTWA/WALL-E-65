## config/west.yml
```yaml
manifest:
  remotes:
    - name: zmkfirmware
      url-base: https://github.com/zmkfirmware
    - name: GITTWA
      url-base: https://github.com/GITTWA
  projects:
    - name: zmk
      remote: zmkfirmware
      revision: v0.3
      import: app/west.yml
    - name: zmk-behavior-CAPS-LOKS-ACCENTATE
      remote: GITTWA
      revision: main
  self:
    path: config
```
